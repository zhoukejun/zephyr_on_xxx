## xxx/boards/sipeed/licheerv_nano/licheerv_nano_c906b/Kconfig.licheerv_nano_c906b
```kconfig
# Copyright (c) 2024 Kejun Zhou <zhoukejun@outlook.com>
# SPDX-License-Identifier: Apache-2.0

config BOARD_LICHEERV_NANO_C906B
	select SOC_SG2002_C906B
```

## xxx/boards/sipeed/licheerv_nano/licheerv_nano_c906b/licheerv_nano_c906b_defconfig
```kconfig
# SPDX-License-Identifier: Apache-2.0

# Floating point options
#CONFIG_FPU=y

CONFIG_CLOCK_CONTROL=y
CONFIG_EVENTS=y
# Enable Console
CONFIG_CONSOLE=y
CONFIG_UART_CONSOLE=y

CONFIG_DISPLAY=y
CONFIG_GPIO=y

CONFIG_LED=y

CONFIG_MIPI_DSI=y

CONFIG_RESET=y

CONFIG_PINCTRL=y

CONFIG_SERIAL=y

CONFIG_SDHC=y

CONFIG_XIP=n

CONFIG_KERNEL_BIN_NAME="zephyr-c906b"
CONFIG_BOOT_BANNER=y
CONFIG_BOOT_BANNER_STRING="Booting LicheeRV_Nano C906B Zephyr OS build"

CONFIG_SHELL=y
CONFIG_SHELL_PROMPT_UART="c906b-> "
# CONFIG_SHELL_BACKEND_SERIAL_INTERRUPT_DRIVEN is not set
CONFIG_SHELL_BACKEND_SERIAL_API_POLLING=y
# CONFIG_SHELL_BACKEND_SERIAL_API_INTERRUPT_DRIVEN is not set
#
CONFIG_MINIMAL_LIBC=y
```

## xxx/boards/sipeed/licheerv_nano/licheerv_nano_c906l/Kconfig.licheerv_nano_c906l
```kconfig
# Copyright (c) 2024 Kejun Zhou <zhoukejun@outlook.com>
# SPDX-License-Identifier: Apache-2.0

config BOARD_LICHEERV_NANO_C906L
	select SOC_SG2002_C906L
```

## xxx/boards/sipeed/licheerv_nano/licheerv_nano_c906l/licheerv_nano_c906l_defconfig
```kconfig
# SPDX-License-Identifier: Apache-2.0

# Floating point options
#CONFIG_FPU=y

# Enable Console
CONFIG_CONSOLE=y
CONFIG_UART_CONSOLE=y

#CONFIG_GPIO=y
#
CONFIG_PINCTRL=y

CONFIG_SERIAL=y

CONFIG_XIP=n

CONFIG_KERNEL_BIN_NAME="zephyr-c906l"
CONFIG_BOOT_BANNER=y
CONFIG_BOOT_BANNER_STRING="Booting C906L Zephyr OS build"

CONFIG_SHELL=y
CONFIG_SHELL_PROMPT_UART="c906l-> "
# CONFIG_SHELL_BACKEND_SERIAL_INTERRUPT_DRIVEN is not set
CONFIG_SHELL_BACKEND_SERIAL_API_POLLING=y
# CONFIG_SHELL_BACKEND_SERIAL_API_INTERRUPT_DRIVEN is not set
```

## xxx/drivers/Kconfig
```kconfig
# Copyright (c) 2024 Kejun Zhou <zhoukejun@outlook.com>
# SPDX-License-Identifier: Apache-2.0

rsource "clock_control/Kconfig"
rsource "pinctrl/Kconfig"
rsource "reset/Kconfig"
rsource "sdhc/Kconfig"
rsource "timer/Kconfig"
```

## xxx/drivers/clock_control/Kconfig
```kconfig
# Copyright (c) 2024 Kejun Zhou <zhoukejun@outlook.com>
# SPDX-License-Identifier: Apache-2.0

rsource "Kconfig.sophgo_sg200x"
```

## xxx/drivers/clock_control/Kconfig.sophgo_sg200x
```kconfig
# Copyright (c) 2024 Kejun Zhou <zhoukejun@outlook.com> 
# SPDX-License-Identifier: Apache-2.0

config CLOCK_CONTROL_SOPHGO_SG200X
	bool "SOPHGO SG200X clock control driver"
	default y
	depends on DT_HAS_SOPHGO_SG200X_CLOCK_ENABLED
	help
	  Enable support for SOPHGO SG200X clock control driver.
```

## xxx/drivers/pinctrl/Kconfig.sophgo
```kconfig
# Copyright (c) 2024 Kejun Zhou <zhoukejun@outlook.com>
# SPDX-License-Identifier: Apache-2.0


config PINCTRL_SOPHGO
	bool "Sophgo pinmux driver"
	default y
	depends on DT_HAS_SOPHGO_PINCTRL_ENABLED
	help
	  Enable driver for the Sophgo pinctrl driver
```

## xxx/drivers/reset/Kconfig.sophgo
```kconfig
# Copyright (c) 2024 Kejun Zhou <zhoukejun@outlook.com>
# SPDX-License-Identifier: Apache-2.0

config RESET_SOPHGO_SG200X
	bool "Sophgo sg200x Reset Controller driver"
	default y
	depends on DT_HAS_SOPHGO_SG200X_RESET_ENABLED
```

## xxx/drivers/sdhc/Kconfig.sophgo
```kconfig
# Copyright (c) 2024 Kejun Zhou <zhoukejun@outlook.com>
# SPDX-License-Identifier: Apache-2.0

config SOPHGO_SDHC
	bool "SOPHGO eMMC/SD/SDIO Driver"
	default y
	depends on DT_HAS_SOPHGO_SG200X_SDHC_ENABLED
	select PINCTRL
	help
	  Enable the Sophgo sg200x eMMC/SD/SDIO host controlller driver

if SOPHGO_SDHC

config SOPHGO_SDHC_EMMC
	bool "eMMc driver"
	default n
	help
	  Enable eMMC support

config SOPHGO_SDHC_SD
	bool "SD driver"
	default n
	help
	  Enable SD support

config SOPHGO_SDHC_SDIO
	bool "SDIO driver"
	default y
	help
	  Enable SDIO support

endif #SOPHGO_SDHC
```

## xxx/drivers/timer/Kconfig
```kconfig
# Copyright (c) 2024 Kejun Zhou <zhoukejun@outlook.com>
# SPDX-License-Identifier: Apache-2.0

config RISCV_MACHINE_TIMER_FOR_THEAD
	bool "RISCV Machine Timer for THEAD"
	default y
	depends on DT_HAS_THEAD_MACHINE_TIMER_ENABLED
	select TICKLESS_CAPABLE
	select TIMER_HAS_64BIT_CYCLE_COUNTER

if RISCV_MACHINE_TIMER_FOR_THEAD

config RISCV_MACHINE_TIMER_SYSTEM_CLOCK_DIVIDER
    default 0

endif
```

## xxx/dts/bindings/clock/sophgo,sg200x-clock.yaml
```yaml
# Copyright (c) 2024 Kejun Zhou <zhoukejun@outlook.com>
# SPDX-License-Identifier: Apache-2.0

description: SOPHGO SG200X SoC clock generator IP node

compatible: "sophgo,sg200x-clock"

include: [clock-controller.yaml, base.yaml]

properties:
  reg:
    required: true

  "#clock-cells":
    const: 1

clock-cells:
  - name
```

## xxx/dts/bindings/pinctrl/sophgo,pinctrl.yaml
```yaml
# Copyright (c) 2024 Kejun Zhou <zhoukejun@outlook.com>
# SPDX-License-Identifier: Apache-2.0

description: |
 Sophgo cv180x, sg200x SoC Pin controller.

  For example, setting pins 18, 19 to uart would look like this:

    #include <zephyr/dt-bindings/pinctrl/sophgo-pinctrl.h>

    &pinctrl {
      uart0_tx_default: uart0_tx_default {
        pinmux = < UART0_TX UART0_TX>;
      };
      uart0_rx_default: uart0_rx_default {
        pinmux = < UART0_RX UART0_RX>;
      };
    };


compatible: "sophgo,pinctrl"

include: base.yaml

properties:
  reg:
    required: true

child-binding:
  properties:
    pinmux:
      required: true
      type: array
```

## xxx/dts/bindings/reset/sophgo,sg2002-reset.yaml
```yaml
# Copyright (c) 2024 Kejun Zhou <zhoukejun@outlook.com>
# SPDX-License-Identifier: Apache-2.0

description: |
  Sophgo sg200x reset controller


compatible: "sophgo,sg200x-reset"

include: [reset-controller.yaml, base.yaml]

properties:
  "#reset-cells":
    const: 1

reset-cells:
  - id
```

## xxx/dts/bindings/sdhc/sophgo,sg200x-sdhc.yaml
```yaml
# Copyright (c) 2024 Kejun Zhou <zhoukejun@outlook.com>
# SPDX-License-Identifier: Apache-2.0

description: SOPHGO SG200X eMMC/SD/SDIO controller

compatible: "sophgo,sg200x-sdhc"

include: [base.yaml, pinctrl-device.yaml]

properties:
  reg:
    required: true

  pinctrl-0:
    required: true

  pinctrl-names:
    required: true

  bus-width:
    type: int
    required: true
 
  reg_names:
    type: string
    required: true

  src-frequency:
    type: int
    required: true

  max-frequency:
    type: int
    required: true

  min-frequency:
    type: int
    required: true

  pll_index:
    type: int
    required: true

  pll_reg:
    type: int
    required: true

  "64_addressing":
    type: boolean

  "reset_tx_rx_phy":
    type: boolean

  "non-removable":
    type: boolean

  "no-mmc":
    type: boolean

  "no-sd":
    type: boolean

  "cap-sd-highspeed":
    type: boolean

  "cap-mmc-highspeed":
    type: boolean

  "sd-uhs-sdr12":
    type: boolean

  "sd-uhs-sdr25":
    type: boolean

  "sd-uhs-sdr50":
    type: boolean

  "sd-uhs-ddr50":
    type: boolean

  "sd-uhs-sdr104":
    type: boolean

  "no-sdio":
    type: boolean

  "no-mmc":
    type: boolean

  reset-names:
    type: string

  gpios:
    type: phandle-array

  pwr-en-gpios:
    type: phandle-array
```

## xxx/soc/sophgo/Kconfig.soc
```kconfig
config SOC_FAMILY_SOPHGO
	bool

config SOC_FAMILY
	default "sophgo" if SOC_FAMILY_SOPHGO

rsource "*/Kconfig.soc"
```

## xxx/soc/sophgo/cv180xb/Kconfig
```kconfig
# Copyright (c) 2024 Kejun Zhou <zhoukejun@outlook.com>
# SPDX-License-Identifier: Apache-2.0

config SOC_SERIES_CV180XB
	bool
	select RISCV
	select 64BIT
	select RISCV_PRIVILEGED
        select RISCV_ISA_RV64I
        select RISCV_ISA_EXT_M
        select RISCV_ISA_EXT_A
        select RISCV_ISA_EXT_F
        select RISCV_ISA_EXT_D
        select RISCV_ISA_EXT_C
        select RISCV_ISA_EXT_ZICSR
        select RISCV_ISA_EXT_ZIFENCEI
	select INCLUDE_RESET_VECTOR
	select ATOMIC_OPERATIONS_C
```

## xxx/soc/sophgo/cv180xb/Kconfig.soc
```kconfig
# Copyright (c) 2024 Kejun Zhou <zhoukejun@outlook.com>
# SPDX-License-Identifier: Apache-2.0

config SOC_SERIES_CV180XB
	bool
	select SOC_FAMILY_SOPHGO

config SOC_CV1800B_C906B
	bool "CV1800B Main Core T-HEAD C906B"
	select SOC_SERIES_CV180XB
	help
	  Enable support for SOPHGO CV1800B main core C906B.

config SOC_CV1800B_C906L
	bool "CV1800B Small Core T-HEAD C906L"
	select SOC_SERIES_CV180XB
	help
	  Enable support for SOPHGO CV1800B small core C906L.

config SOC_SERIES
	default "cv180xb" if SOC_SERIES_CV180XB

config SOC
	default "cv1800b" if SOC_CV1800B_C906B || SOC_CV1800B_C906L
```

## xxx/soc/sophgo/sg200x/Kconfig.soc
```kconfig
# Copyright (c) 2024 Kejun Zhou <zhoukejun@outlook.com>
# SPDX-License-Identifier: Apache-2.0

config SOC_SERIES_SG200X
	bool
	select SOC_FAMILY_SOPHGO

config SOC_SG2002_C906B
	bool "SG2002 Main Core T-HEAD C906B"
	select SOC_SERIES_SG200X
	help
	  Enable support for SOPHGO SG2002 main core C906B.

config SOC_SG2002_C906L
	bool "SG2002 Small Core T-HEAD C906L"
	select SOC_SERIES_SG200X
	help
	  Enable support for SOPHGO SG2002 small core C906L.

config SOC_SERIES
	default "sg200x" if SOC_SERIES_SG200X

config SOC
	default "sg2002" if SOC_SG2002_C906B || SOC_SG2002_C906L
```
